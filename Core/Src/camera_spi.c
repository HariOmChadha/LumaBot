// camera_spi.c
#include "camera_spi.h"
#include "lcd_display.h"
#include "cmsis_os.h"

// from CubeMX (for configuration and data)
extern I2C_HandleTypeDef hi2c1;
extern SPI_HandleTypeDef hspi2;

extern osSemaphoreId_t spiDmaSemaphore;

static uint8_t camera_dma_state = 0;
static uint8_t *camera_dma_ptr = NULL;

static const struct sensor_reg OV2640_QVGA_RGB565[] = {
	{0xff, 0x0},
	{0x2c, 0xff},
	{0x2e, 0xdf},
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	{0xff, 0xff},
};

uint8_t Camera_ReadReg(uint8_t addr)
{

	uint8_t tx_data[2] = {addr & 0x7F, 0x00};
	uint8_t rx_data[2] = {0, 0};

	HAL_GPIO_WritePin(GPIOG, GPIO_PIN_7, GPIO_PIN_RESET); // cs low
	HAL_StatusTypeDef status = HAL_SPI_TransmitReceive(&hspi2, tx_data, rx_data, 2, 100);
	HAL_GPIO_WritePin(GPIOG, GPIO_PIN_7, GPIO_PIN_SET); // cs high

	// error tracking
	if (status == HAL_TIMEOUT)
		return 0xEE;
	if (status == HAL_ERROR)
		return 0xDD;
	if (status == HAL_BUSY)
		return 0xBB;

	return rx_data[1];
}

uint8_t Camera_WriteReg(uint8_t addr, uint8_t data)
{
	uint8_t tx_data[2] = {addr | 0x80, data};

	HAL_GPIO_WritePin(GPIOG, GPIO_PIN_7, GPIO_PIN_RESET); // cs low
	HAL_StatusTypeDef status = HAL_SPI_Transmit(&hspi2, tx_data, 2, 100);
	HAL_GPIO_WritePin(GPIOG, GPIO_PIN_7, GPIO_PIN_SET); // cs high

	if (status == HAL_TIMEOUT)
		return 0xEE;
	if (status == HAL_ERROR)
		return 0xDD;
	if (status == HAL_BUSY)
		return 0xBB;

	return 0;
}

uint8_t Camera_Init(uint8_t *out_spi_val)
{
	if (HAL_I2C_IsDeviceReady(&hi2c1, 0x60, 5, 100) != HAL_OK)
		return 1;

	osDelay(10);

	Camera_WriteReg(ARDUCHIP_TEST1, 0xFF);
	Camera_ReadReg(ARDUCHIP_TEST1);

	// check read/write statuses
	uint8_t write_status = Camera_WriteReg(ARDUCHIP_TEST1, 0x55);
	if (write_status != 0)
		return write_status;

	uint8_t read_val = Camera_ReadReg(ARDUCHIP_TEST1);

	// send physical value to UI for debugging purposes
	if (out_spi_val != NULL)
	{
		*out_spi_val = read_val;
	}

	// HAL error handling
	if (read_val == 0xEE || read_val == 0xDD || read_val == 0xBB)
		return read_val;

	// data is wrong
	if (read_val != 0x55)
		return 2;

	uint8_t reset_bank = 0x01;
	uint8_t reset_cmd = 0x80;

	// reset vals
	HAL_I2C_Mem_Write(&hi2c1, 0x60, 0xFF, I2C_MEMADD_SIZE_8BIT, &reset_bank, 1, 100);
	osDelay(10);
	HAL_I2C_Mem_Write(&hi2c1, 0x60, 0x12, I2C_MEMADD_SIZE_8BIT, &reset_cmd, 1, 100);
	osDelay(100);

	for (int i = 0; (OV2640_QVGA_RGB565[i].reg != 0xff) || (OV2640_QVGA_RGB565[i].val != 0xff); i++)
	{
		uint8_t current_val = OV2640_QVGA_RGB565[i].val;
		if (HAL_I2C_Mem_Write(&hi2c1, 0x60, OV2640_QVGA_RGB565[i].reg, I2C_MEMADD_SIZE_8BIT, &current_val, 1, 100) != HAL_OK)
		{
			return 3;
		}
		osDelay(1);
	}
	osDelay(100);

	return 0;
}

void Camera_Start_DMA_Capture(uint16_t *dest_buffer)
{
	HAL_GPIO_WritePin(GPIOG, GPIO_PIN_7, GPIO_PIN_RESET); // cs low

	uint8_t burst_cmd = 0x3C;
	HAL_SPI_Transmit(&hspi2, &burst_cmd, 1, 10);

	uint8_t dummy;
	HAL_SPI_Receive(&hspi2, &dummy, 1, 10);

	// save destination and set to transfer first chunk
	// need to transfer data in two chunks b/c size constraints
	camera_dma_ptr = (uint8_t *)dest_buffer;
	camera_dma_state = 1;

	HAL_SPI_TransmitReceive_DMA(&hspi2, camera_dma_ptr, camera_dma_ptr, 60000);
}

void HAL_SPI_TxRxCpltCallback(SPI_HandleTypeDef *hspi)
{
	if (hspi->Instance == SPI2)
	{
		if (camera_dma_state == 1)
		{
			camera_dma_state = 2; // first chunk
			HAL_SPI_TransmitReceive_DMA(&hspi2, camera_dma_ptr + 60000, camera_dma_ptr + 60000, 60000);
		}
		else if (camera_dma_state == 2)
		{
			camera_dma_state = 3; // next chunk
			HAL_SPI_TransmitReceive_DMA(&hspi2, camera_dma_ptr + 120000, camera_dma_ptr + 120000, 33600);
		}
		else if (camera_dma_state == 3)
		{
			camera_dma_state = 0;
			HAL_GPIO_WritePin(GPIOG, GPIO_PIN_7, GPIO_PIN_SET); // cs high

			osSemaphoreRelease(spiDmaSemaphore);
		}
	}
}
